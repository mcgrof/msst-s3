## Kconfig
```kconfig
# SPDX-License-Identifier: GPL-2.0
mainmenu "Multi-vendor S3 Storage Test Suite (MSST-S3) Configuration"

# S3 Endpoint Configuration
menu "S3 Endpoint Configuration"

config S3_ENDPOINT_URL
	string "S3 endpoint URL"
	output yaml
	default "http://localhost:9000"
	help
	  The S3-compatible endpoint URL to test against.
	  Examples:
	  - AWS S3: https://s3.amazonaws.com
	  - MinIO: http://localhost:9000
	  - Ceph RGW: http://localhost:7480

config S3_ACCESS_KEY
	string "S3 access key"
	output yaml
	default "minioadmin"
	help
	  Access key for S3 authentication.

config S3_SECRET_KEY
	string "S3 secret key"
	output yaml
	default "minioadmin"
	help
	  Secret key for S3 authentication.

config S3_REGION
	string "S3 region"
	output yaml
	default "us-east-1"
	help
	  AWS region for the S3 endpoint.
	  Use 'us-east-1' for most S3-compatible systems.

config S3_USE_SSL
	bool "Use SSL/TLS"
	output yaml
	default n
	help
	  Enable SSL/TLS for secure connections.

config S3_VERIFY_SSL
	bool "Verify SSL certificates"
	output yaml
	depends on S3_USE_SSL
	default y
	help
	  Verify SSL certificates. Disable for self-signed certificates.

config S3_BUCKET_PREFIX
	string "Test bucket prefix"
	output yaml
	default "msst-test"
	help
	  Prefix for test bucket names. Each test will append
	  its test number to create unique bucket names.

endmenu

# Test Selection
menu "Test Selection"

config TEST_BASIC
	bool "Basic S3 operations (001-099)"
	output yaml
	default y
	help
	  Enable basic S3 operation tests including:
	  - Bucket CRUD operations
	  - Object PUT/GET/DELETE
	  - Simple listing operations

config TEST_MULTIPART
	bool "Multipart upload tests (100-199)"
	output yaml
	default y
	help
	  Enable multipart upload tests including:
	  - Small multipart uploads
	  - Large file uploads
	  - Concurrent part uploads
	  - Abort and resume operations

config TEST_VERSIONING
	bool "Versioning tests (200-299)"
	output yaml
	default n
	help
	  Enable object versioning tests including:
	  - Version creation and listing
	  - Version deletion
	  - Version restoration

config TEST_ACL
	bool "Access control tests (300-399)"
	output yaml
	default n
	help
	  Enable access control tests including:
	  - Bucket ACLs
	  - Object ACLs
	  - Canned ACLs
	  - Cross-account access

config TEST_ENCRYPTION
	bool "Encryption tests (400-499)"
	output yaml
	default n
	help
	  Enable encryption tests including:
	  - SSE-S3 (server-side encryption with S3 managed keys)
	  - SSE-C (customer provided keys)
	  - SSE-KMS (key management service)

config TEST_LIFECYCLE
	bool "Lifecycle tests (500-599)"
	output yaml
	default n
	help
	  Enable lifecycle management tests including:
	  - Expiration policies
	  - Transition policies
	  - Noncurrent version expiration

config TEST_PERFORMANCE
	bool "Performance tests (600-699)"
	output yaml
	default n
	help
	  Enable performance tests to measure:
	  - Upload/download throughput
	  - Operation latency
	  - Concurrent operation scaling

config TEST_STRESS
	bool "Stress tests (700-799)"
	output yaml
	default n
	help
	  Enable stress tests including:
	  - High concurrency operations
	  - Large number of objects
	  - Extended duration tests

config TEST_COMPATIBILITY
	bool "Vendor compatibility tests (800-899)"
	output yaml
	default n
	help
	  Enable vendor-specific compatibility tests
	  for different S3 implementations.

endmenu

# Test Parameters
menu "Test Parameters"

config TEST_RUN_MODE
	string "Test run mode"
	output yaml
	default "sequential"
	help
	  Test execution mode:
	  - sequential: Run tests one by one
	  - parallel: Run tests in parallel
	  - group: Run test groups in parallel

config TEST_PARALLEL_JOBS
	int "Parallel test jobs"
	output yaml
	depends on TEST_RUN_MODE = "parallel" || TEST_RUN_MODE = "group"
	default 4
	range 1 32
	help
	  Number of parallel test jobs to run.

config TEST_TIMEOUT
	int "Test timeout (seconds)"
	output yaml
	default 300
	range 10 3600
	help
	  Maximum time allowed for a single test to complete.

config TEST_RETRY_COUNT
	int "Test retry count"
	output yaml
	default 3
	range 0 10
	help
	  Number of times to retry a failed test.

config TEST_OBJECT_SIZES
	string "Object sizes for tests"
	output yaml
	default "1KB,1MB,10MB,100MB"
	help
	  Comma-separated list of object sizes to test.
	  Supports units: B, KB, MB, GB.

config TEST_BUCKET_COUNT
	int "Number of buckets per test"
	output yaml
	default 5
	range 1 100
	help
	  Number of buckets to create in tests that use multiple buckets.

config TEST_OBJECT_COUNT
	int "Number of objects per test"
	output yaml
	default 10
	range 1 10000
	help
	  Number of objects to create in tests that use multiple objects.

endmenu

# Performance Test Configuration
menu "Performance Test Configuration"
	depends on TEST_PERFORMANCE

config PERF_DURATION
	int "Performance test duration (seconds)"
	output yaml
	default 60
	range 10 3600
	help
	  Duration for each performance test run.

config PERF_CONCURRENT_CLIENTS
	int "Concurrent clients"
	output yaml
	default 10
	range 1 1000
	help
	  Number of concurrent clients for performance testing.

config PERF_WARMUP_TIME
	int "Warmup time (seconds)"
	output yaml
	default 10
	range 0 60
	help
	  Warmup period before collecting performance metrics.

config PERF_COLLECT_METRICS
	bool "Collect detailed metrics"
	output yaml
	default y
	help
	  Collect detailed performance metrics including
	  latency percentiles and throughput statistics.

endmenu

# Stress Test Configuration
menu "Stress Test Configuration"
	depends on TEST_STRESS

config STRESS_DURATION
	int "Stress test duration (seconds)"
	output yaml
	default 300
	range 60 86400
	help
	  Duration for stress test execution.

config STRESS_MAX_OBJECTS
	int "Maximum objects to create"
	output yaml
	default 10000
	range 100 1000000
	help
	  Maximum number of objects to create during stress testing.

config STRESS_CONCURRENT_OPS
	int "Concurrent operations"
	output yaml
	default 100
	range 10 10000
	help
	  Number of concurrent operations during stress testing.

config STRESS_MIXED_WORKLOAD
	bool "Use mixed workload"
	output yaml
	default y
	help
	  Mix different operation types (PUT, GET, DELETE) in stress tests.

endmenu

# Output Configuration
menu "Output Configuration"

config OUTPUT_FORMAT
	string "Output format"
	output yaml
	default "json"
	help
	  Test result output format:
	  - json: JSON format
	  - yaml: YAML format
	  - junit: JUnit XML format
	  - text: Human-readable text

config OUTPUT_VERBOSE
	int "Verbosity level"
	output yaml
	default 1
	range 0 3
	help
	  Output verbosity level:
	  0 - Quiet (errors only)
	  1 - Normal (test results)
	  2 - Verbose (detailed information)
	  3 - Debug (all output)

config OUTPUT_DIR
	string "Output directory"
	output yaml
	default "./results"
	help
	  Directory to store test results and logs.

config OUTPUT_TIMESTAMP
	bool "Add timestamp to output files"
	output yaml
	default y
	help
	  Add timestamp to output file names for unique identification.

config OUTPUT_SAVE_LOGS
	bool "Save detailed logs"
	output yaml
	default y
	help
	  Save detailed test execution logs for debugging.

endmenu

# Ansible Integration
menu "Ansible Integration"

config ANSIBLE_ENABLED
	bool "Enable Ansible integration"
	output yaml
	default n
	help
	  Enable Ansible playbook integration for automated testing.

config ANSIBLE_INVENTORY
	string "Ansible inventory file"
	output yaml
	depends on ANSIBLE_ENABLED
	default "./playbooks/inventory/hosts"
	help
	  Path to Ansible inventory file.

config ANSIBLE_PLAYBOOK
	string "Main Ansible playbook"
	output yaml
	depends on ANSIBLE_ENABLED
	default "./playbooks/s3-tests.yml"
	help
	  Path to main Ansible playbook for test execution.

config ANSIBLE_VERBOSE
	bool "Verbose Ansible output"
	output yaml
	depends on ANSIBLE_ENABLED
	default n
	help
	  Enable verbose output from Ansible playbooks.

endmenu

# Vendor-Specific Configuration
menu "Vendor-Specific Settings"

config VENDOR_TYPE
	string "S3 vendor type"
	output yaml
	default "generic"
	help
	  S3 implementation type:
	  - generic: Generic S3-compatible
	  - aws: Amazon Web Services S3
	  - minio: MinIO
	  - ceph: Ceph RADOS Gateway
	  - gcs: Google Cloud Storage
	  - azure: Azure Blob Storage
	  - wasabi: Wasabi
	  - digitalocean: DigitalOcean Spaces

config VENDOR_SKIP_TESTS
	string "Tests to skip for this vendor"
	output yaml
	default ""
	help
	  Comma-separated list of test numbers to skip
	  for the configured vendor.

config VENDOR_SPECIFIC_CONFIG
	string "Vendor-specific configuration file"
	output yaml
	default ""
	help
	  Path to vendor-specific configuration file
	  with additional settings.

endmenu

# Developer Options
menu "Developer Options"

config DEBUG_ENABLED
	bool "Enable debug mode"
	output yaml
	default n
	help
	  Enable debug mode with additional logging and checks.

config DEBUG_KEEP_BUCKETS
	bool "Keep test buckets after tests"
	output yaml
	depends on DEBUG_ENABLED
	default n
	help
	  Do not delete test buckets after test completion.
	  Useful for debugging failed tests.

config DEBUG_DUMP_REQUESTS
	bool "Dump HTTP requests"
	output yaml
	depends on DEBUG_ENABLED
	default n
	help
	  Dump all HTTP requests and responses for debugging.

config DEBUG_SLOW_MODE
	bool "Slow mode execution"
	output yaml
	depends on DEBUG_ENABLED
	default n
	help
	  Add delays between operations for easier debugging.

endmenu
```

## configs/defconfig
```kconfig
# Default configuration for MSST-S3

# S3 Endpoint
CONFIG_S3_ENDPOINT_URL="http://localhost:9000"
CONFIG_S3_ACCESS_KEY="minioadmin"
CONFIG_S3_SECRET_KEY="minioadmin"
CONFIG_S3_REGION="us-east-1"
# CONFIG_S3_USE_SSL is not set
CONFIG_S3_BUCKET_PREFIX="msst-test"

# Enable basic tests by default
CONFIG_TEST_BASIC=y
CONFIG_TEST_MULTIPART=y
# CONFIG_TEST_VERSIONING is not set
# CONFIG_TEST_ACL is not set
# CONFIG_TEST_ENCRYPTION is not set
# CONFIG_TEST_LIFECYCLE is not set
# CONFIG_TEST_PERFORMANCE is not set
# CONFIG_TEST_STRESS is not set
# CONFIG_TEST_COMPATIBILITY is not set

# Test parameters
CONFIG_TEST_RUN_MODE="sequential"
CONFIG_TEST_TIMEOUT=300
CONFIG_TEST_RETRY_COUNT=3
CONFIG_TEST_OBJECT_SIZES="1KB,1MB,10MB,100MB"
CONFIG_TEST_BUCKET_COUNT=5
CONFIG_TEST_OBJECT_COUNT=10

# Output
CONFIG_OUTPUT_FORMAT="json"
CONFIG_OUTPUT_VERBOSE=1
CONFIG_OUTPUT_DIR="./results"
CONFIG_OUTPUT_TIMESTAMP=y
CONFIG_OUTPUT_SAVE_LOGS=y

# Vendor
CONFIG_VENDOR_TYPE="generic"

# Debug
# CONFIG_DEBUG_ENABLED is not set
```
